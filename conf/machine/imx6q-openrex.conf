## conf/machine/imx6q-openrex.conf
```bitbake
#@TYPE: Machine
#@NAME: FEDEVEL i.MX6Q OpenRex
#@SOC: i.MX6Q
#@DESCRIPTION: Machine configuration for FEDEVEL i.MX6Q OpenRex
#@MAINTAINER: Robert Feranec <info@fedevel.com>

require conf/machine/include/imx6openrex-common.inc

SOC_FAMILY = "mx6:mx6q"

PREFERRED_PROVIDER_u-boot_mx6 = "u-boot-openrex"
PREFERRED_PROVIDER_virtual/kernel_mx6 = "linux-openrex"
PREFERRED_VERSION_linux-openrex ?= "3.14"

KERNEL_DEVICETREE = "imx6q-openrex.dtb"

UBOOT_CONFIG ??= "sd"
UBOOT_CONFIG[sd] = "mx6qopenrex_config,sdcard"
UBOOT_CONFIG[mfgtool] = "mx6qopenrex_config"
```

## conf/machine/imx6s-openrex.conf
```bitbake
#@TYPE: Machine
#@NAME: FEDEVEL i.MX6S OpenRex
#@SOC: i.MX6S
#@DESCRIPTION: Machine configuration for FEDEVEL i.MX6 SOLO OpenRex
#@MAINTAINER: Robert Feranec <info@fedevel.com>

require conf/machine/include/imx6openrex-common.inc

SOC_FAMILY = "mx6:mx6dl"

PREFERRED_PROVIDER_u-boot_mx6 = "u-boot-openrex"
PREFERRED_PROVIDER_virtual/kernel_mx6 = "linux-openrex"
PREFERRED_VERSION_linux-openrex ?= "3.14"

KERNEL_DEVICETREE = "imx6s-openrex.dtb"

UBOOT_CONFIG ??= "sd"
UBOOT_CONFIG[sd] = "mx6sopenrex_config,sdcard"
UBOOT_CONFIG[mfgtool] = "mx6sopenrex_config"
```
